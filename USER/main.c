/**--------------File Info---------------------------------------------------------------------------------
** File name:               main.c
** Descriptions:            Robot Seda tracción diferencial controlado a través de UART, servidor empotrado, mando 
**                          nunchuck. Tiene 3 modos de funcionamiento, en cada uno muestra y obedece a distintas cosas.
**
**--------------------------------------------------------------------------------------------------------
** Created by:              Arantxa Barcenilla San Segundo, Ignacio Garcia Godin
** Created date:            2023-01-08
** Version:                 v1.0
** Descriptions:            The original version
**
**--------------------------------------------------------------------------------------------------------
** Modified by:             
** Modified date:           
** Version:                 
** Descriptions:            
**
*********************************************************************************************************/

/* Includes ------------------------------------------------------------------*/


#include <LPC17xx.h>                    /* LPC17xx definitions               */
#include <glcd.h>
#include <TouchPanel.h>
#include <string.h>
#include <math.h>
#include "uart.h"
#include <stdlib.h>
#include <stdio.h>
#include <RTL.h>
#include <Net_Config.h>
#include "i2c_lpc17xx.h"

#define Fpclk 25e6	// Fcpu/4 (defecto después del reset)
#define Tpwm 1e-3	// Perido de la señal PWM (1ms)
#define T_tim2 100e-3 
uint32_t  N1;						// variable global para trazar el Nº de cuentas entre flancos
uint32_t  N2;
#define R 3.35 //dato en cm
#define PPV 400 //dato
#define pi 3.1415
#define N100ms Fpclk*T_tim2
#define DisRuedas 20
#define DisGrad 180/pi
#define F_muestreo 10 // Fs=10Hz (Cada 20 us se toma una muestra del canal 2,5)
#define F_sample 8000
#define N_muestras 15000 // igual a la longitud del array generado en Matlab
#define Ttim0 10e-6

extern   U32 CheckMedia (void);

int8_t datoX,datoY,datoC,datoZ,datoBasura,datoZC;

uint16_t M_manual;
uint16_t M_auto=1;
uint16_t M_debug;
uint16_t flagServer=0;

char buffer[80];		// Buffer de recepción de 30 caracteres
char buffer_tx[80];		// Buffer de recepción de 30 caracteres
char *ptr_rx;			// puntero de recepción
char rx_completa;		// Flag de recepción de cadena que se activa a "1" al recibir la tecla return CR(ASCII=13)
char *ptr_tx;			// puntero de transmisión
char tx_completa;		// Flag de transmisión de cadena que se activa al transmitir el caracter null (fin de cadena)
int estadoUart=0,opcion=0;
int modo=0;
int vel=0;


int audio=0,parar=0,segundos=0,mute=0,fin=0,vez=0,activo=0;
//uint8_t muestras[]={128,128,128,128,128,128,128,128,128,128,128,128,128,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128,128}; 
uint8_t muestras[]={125,118,126,146,145,145,145,145,146,145,146,145,145,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121,121}; 

uint16_t muestrasTono[20];

uint32_t tensionPot,tensionBateria=0,Bateria=0,cambioServer=0;

////-- Definición de tipos de estados
//enum { inicio, signo, adquisicion, ejecucion, derecha, izquierda } ESTADOS;

//enum ESTADOS estado;

int estado=0;
char cadena[20]="";

int indice=0;
float array[25]; //para guardar los 10 valores de batería
float aux=0;

/* Estructura que define una zona de la pantalla */
struct t_screenZone
{
  uint16_t x;         
	uint16_t y;
	uint16_t size_x;
	uint16_t size_y;
	uint8_t  pressed;
};


/* Definicion de las diferentes zonas de la pantalla */

struct t_screenZone zone_1 = { 20, 25, 200, 55, 0}; /* cuadrado 1   */
struct t_screenZone zone_2 = { 70, 30, 100, 20, 0}; /* velocidades   */
struct t_screenZone zone_3 = { 30, 45, 35, 35, 0}; /* menos   */
struct t_screenZone zone_4 = { 70, 45, 45, 35, 0}; /* velIzquierda   */
struct t_screenZone zone_5 = { 125, 45, 45, 35, 0}; /* VelDerecha   */
struct t_screenZone zone_6 = { 175, 45, 35, 35, 0}; /* más   */
struct t_screenZone zone_7 = { 20, 85, 200, 45, 0}; /* cuadrado 2   */
struct t_screenZone zone_8 = { 70, 90, 100, 20, 0}; /* posición   */
struct t_screenZone zone_9 = { 70, 110, 100, 20, 0}; /* distancia   */
struct t_screenZone zone_10 = { 20, 135, 200, 85, 0}; /* cuadrado 3   */
struct t_screenZone zone_11 = { 70, 140, 100, 20, 0}; /* v1D   */
struct t_screenZone zone_12 = { 70, 160, 100, 20, 0}; /* v2D   */
struct t_screenZone zone_13 = { 70, 180, 100, 20, 0}; /* v1I   */
struct t_screenZone zone_14 = { 70, 200, 100, 20, 0}; /* v2I   */
struct t_screenZone zone_15 = { 20, 225, 200, 85, 0}; /* cuadrado 4   */
struct t_screenZone zone_16 = { 30, 230, 85, 20, 0}; /* batería   */
struct t_screenZone zone_17 = { 30, 270, 85, 20, 0}; /* umbral   */
struct t_screenZone zone_18 = { 130, 245, 85, 25, 0}; /* señal   */



/* Flag que indica si se detecta una pulsación válida */
uint8_t pressedTouchPanel = 0;

/* Variable que contiene los datos del programa */
static int velDerecha = 0 ;
static int velIzquierda = 0;
float posicion = 0;
float Distancia = 0;
/* Variable temporal donde almacenar cadenas de caracteres */
char texto1[25];
char texto2[25];
char texto3[25];
char texto4[25];
char texto5[25];
char texto6[25];
char texto7[25];
char texto8[25];
char texto9[25];
char texto10[25];
char texto11[25];


float frecuencia1;
float frecuencia2;
float velocidad1D;
float velocidad1I;
float velocidad2D;
float velocidad2I;
float contadorPulsos1=0;
float contadorPulsos2=0;
float Lder=0;
float Lizq=0;
float LderT=0;
float LizqT=0;


int contador=5; //para la función pausa
int flag=0;
int dist=0;
int sentido=0;  //0 es positivo y 1 es negativo distancia
int angulo=0; //0 es derecha y 1 es izquierda
int a=1; //1 es recto y 0 es pausa
float posicionDeltaT;



/*--------------------------- init ------------------------------------------*/

/*******************************************************************************
* Function Name  : init
* Description    : Initialize every subsystem
* Input          : None
* Output         : None
* Return         : None
* Attention		  : None
*******************************************************************************/
static void init () {

  /*  Serial init for debug. Need enviroment constant __UART0, __UART1 o __DBG_ITM  */

  init_TcpNet ();
   
  /* Setup and enable the SysTick timer for 100ms. */
  SysTick->LOAD = (SystemCoreClock / 10) - 1;
  SysTick->CTRL = 0x05;

}


/*--------------------------- timer_poll ------------------------------------*/

/*******************************************************************************
* Function Name  : timer_poll
* Description    : Call timer_tick() if every 100ms (aprox) 
* Input          : None
* Output         : None
* Return         : None
* Attention		  : None
*******************************************************************************/
static void timer_poll () {
  /* System tick timer running in poll mode */

  if (SysTick->CTRL & 0x10000) {
    /* Timer tick every 100 ms */
    timer_tick ();
  }
}

/*******************************************************************************
* Function Name  : squareButton
* Description    : Dibuja un cuadrado en las coordenadas especificadas colocando 
*                  un texto en el centro del recuadro
* Input          : zone: zone struct
*                  text: texto a representar en el cuadro
*                  textColor: color del texto
*                  lineColor: color de la línea
* Output         : None
* Return         : None
* Attention		  : None
*******************************************************************************/
void squareButton(struct t_screenZone* zone, char * text, uint16_t textColor, uint16_t lineColor)
{
   LCD_DrawLine( zone->x, zone->y, zone->x + zone->size_x, zone->y, lineColor);
   LCD_DrawLine( zone->x, zone->y, zone->x, zone->y + zone->size_y, lineColor);
   LCD_DrawLine( zone->x, zone->y + zone->size_y, zone->x + zone->size_x, zone->y + zone->size_y, lineColor);
   LCD_DrawLine( zone->x + zone->size_x, zone->y, zone->x + zone->size_x, zone->y + zone->size_y, lineColor);
	GUI_Text(zone->x + zone->size_x/2 - (strlen(text)/2)*8, zone->y + zone->size_y/2 - 8,
            (uint8_t*) text, textColor, Black);	
}

/*******************************************************************************
* Function Name  : drawMinus
* Description    : Draw a minus sign in the center of the zone
* Input          : zone: zone struct
*                  lineColor
* Output         : None
* Return         : None
* Attention		  : None
*******************************************************************************/
void drawMinus(struct t_screenZone* zone, uint16_t lineColor)
{
   LCD_DrawLine( zone->x + 5 , zone->y + zone->size_y/2 - 1, 
                 zone->x + zone->size_x-5, zone->y + zone->size_y/2 - 1,
                 lineColor);
   LCD_DrawLine( zone->x + 5 , zone->y + zone->size_y/2, 
                 zone->x + zone->size_x-5, zone->y + zone->size_y/2,
                 lineColor);
   LCD_DrawLine( zone->x + 5 , zone->y + zone->size_y/2 + 1, 
                 zone->x + zone->size_x-5, zone->y + zone->size_y/2 + 1,
                 lineColor);
}

/*******************************************************************************
* Function Name  : drawMinus
* Description    : Draw a minus sign in the center of the zone
* Input          : zone: zone struct
*                  lineColor
* Output         : None
* Return         : None
* Attention		  : None
*******************************************************************************/
void drawAdd(struct t_screenZone* zone, uint16_t lineColor)
{
   drawMinus(zone, lineColor);
   
   LCD_DrawLine( zone->x + zone->size_x/2 - 1,  zone->y + 5 ,
                 zone->x + zone->size_x/2 - 1,  zone->y + zone->size_y - 5, 
                 lineColor);
   LCD_DrawLine( zone->x + zone->size_x/2 ,  zone->y + 5 ,
                 zone->x + zone->size_x/2 ,  zone->y + zone->size_y - 5, 
                 lineColor);
   LCD_DrawLine( zone->x + zone->size_x/2 + 1,  zone->y + 5 ,
                 zone->x + zone->size_x/2 + 1,  zone->y + zone->size_y - 5, 
                 lineColor);
}

/*******************************************************************************
* Function Name  : screenMain
* Description    : Visualiza la pantalla principal
* Input          : None
* Output         : None
* Return         : None
* Attention		  : None
*******************************************************************************/
void screenMain(void)
{
	 squareButton(&zone_1, "", Black, Blue2);
	 squareButton(&zone_2, "Velocidades izq y der", White, Black);
	 squareButton(&zone_7, "", Black, Blue2);
	 squareButton(&zone_10, "", Black, Blue2);
	 squareButton(&zone_15, "", Black, Blue2);
   drawMinus(&zone_3, Green);
   drawAdd(&zone_6, Green);
}

/*******************************************************************************
* Function Name  : checkTouchPanel
* Description    : Lee el TouchPanel y almacena las coordenadas si detecta pulsación
* Input          : None
* Output         : Modifica pressedTouchPanel
*                    0 - si no se detecta pulsación
*                    1 - si se detecta pulsación
*                        En este caso se actualizan las coordinadas en la estructura display
* Return         : None
* Attention		  : None
*******************************************************************************/
void checkTouchPanel(void)
{
	Coordinate* coord;
	
	coord = Read_Ads7846();
	
	if (coord > 0) {
	  getDisplayPoint(&display, coord, &matrix );
     pressedTouchPanel = 1;
   }   
   else
   {   
     pressedTouchPanel = 0;
      
     // Esto es necesario hacerlo si hay dos zonas diferentes en 
     // dos pantallas secuenciales que se solapen      
     zone_1.pressed = 1;
     zone_2.pressed = 1;
     zone_3.pressed = 1;
     zone_4.pressed = 1;
     zone_5.pressed = 1;
     zone_6.pressed = 1;
		 zone_7.pressed = 1;
     zone_8.pressed = 1;
     zone_9.pressed = 1;
     zone_10.pressed = 1;
     zone_11.pressed = 1;
     zone_12.pressed = 1;
		 zone_13.pressed = 1;
     zone_14.pressed = 1;
     zone_15.pressed = 1;
     zone_16.pressed = 1;
     zone_17.pressed = 1;
		 zone_18.pressed = 1;
   }  
}

/*******************************************************************************
* Function Name  : zonePressed
* Description    : Detecta si se ha producido una pulsación en una zona contreta
* Input          : zone: Estructura con la información de la zona
* Output         : Modifica zone->pressed
*                    0 - si no se detecta pulsación en la zona
*                    1 - si se detecta pulsación en la zona
* Return         : 0 - si no se detecta pulsación en la zona
*                  1 - si se detecta pulsación en la zona
* Attention		  : None
*******************************************************************************/
int8_t zonePressed(struct t_screenZone* zone)
{
	if (pressedTouchPanel == 1) {

		if ((display.x > zone->x) && (display.x < zone->x + zone->size_x) && 
			  (display.y > zone->y) && (display.y < zone->y + zone->size_y))
      {
         zone->pressed = 1;
		   return 1;
      }   
	}
   
	zone->pressed = 0;
	return 0;
}

/*******************************************************************************
* Function Name  : zoneNewPressed
* Description    : Detecta si se ha producido el flanco de una nueva pulsación en 
*                  una zona contreta
* Input          : zone: Estructura con la información de la zona
* Output         : Modifica zone->pressed
*                    0 - si no se detecta pulsación en la zona
*                    1 - si se detecta pulsación en la zona
* Return         : 0 - si no se detecta nueva pulsación en la zona
*                  1 - si se detecta una nueva pulsación en la zona
* Attention		  : None
*******************************************************************************/
int8_t zoneNewPressed(struct t_screenZone* zone)
{
	if (pressedTouchPanel == 1) {

		if ((display.x > zone->x) && (display.x < zone->x + zone->size_x) && 
			  (display.y > zone->y) && (display.y < zone->y + zone->size_y))
      {
         if (zone->pressed == 0)
         {   
            zone->pressed = 1;
            return 1;
         }
		   return 0;
      }
	}

   zone->pressed = 0;
	return 0;
}

void setVelDerecha(float velDcha){
	if(velDcha<0) {                        
		LPC_PWM1->MR2= LPC_PWM1->MR0*(-velDcha)/100; // duty cycle	  
		LPC_GPIO0->FIOCLR3 |= (1<<0) ; LPC_GPIO0->FIOSET2 |= (1<<7);  // in1=1 in2=0
	}
	else { 
		LPC_PWM1->MR2= LPC_PWM1->MR0*(velDcha)/100; // duty cycle
		LPC_GPIO0->FIOCLR2 |= (1<<7) ; LPC_GPIO0->FIOSET3 |= (1<<0); //in1=0 in2=1  porque las ruedas están al revés		
	}
  LPC_PWM1->LER|= (1 << 2)|(1<<0); // PWMLER[0-1]=1
} 

void setVelIzquierda(float velIzqda){ 
	if(velIzqda<0){               //marcha atrás
		LPC_PWM1->MR3= LPC_PWM1->MR0*(-velIzqda)/100; // duty cycle
    LPC_GPIO0->FIOCLR1 |= (1<<3) ;  LPC_GPIO0->FIOSET1 |= (1<<2);  //in3=1 in4=0
	} 
	else{
		LPC_PWM1->MR3= LPC_PWM1->MR0*(velIzqda)/100; // duty cycle
	  LPC_GPIO0->FIOCLR1 |= (1<<2) ;  LPC_GPIO0->FIOSET1 |= (1<<3); // in3=0 in4=1		
	}
  LPC_PWM1->LER|= (1 << 3)|(1<<0); // PWMLER[0-1]=1
}
                                               

void configPWM(void) {           // se usa para los enable de los motores, va a empujones
   LPC_PINCON->PINSEL7|=(3<<18); // P3.25 salida PWM (PWM1.2)
	 LPC_PINCON->PINSEL7|=(3<<20); // P3.26 salida PWM (PWM1.3)
   LPC_SC->PCONP|=(1<<6);
   LPC_PWM1->MR0=Fpclk*Tpwm-1;
   LPC_PWM1->PCR|=(1<<10); //configurado el ENA2 (1.2)
	 LPC_PWM1->PCR|=(1<<11); //configurado el ENA3 (1.3)
   LPC_PWM1->MCR|=(1<<1); //reset en MR0
   LPC_PWM1->TCR|=(1<<0)|(1<<3); //enable contador y pwm
}

void pines(void){
	
	 LPC_PINCON->PINSEL1|=(0<<14) | (0<<15); // p0.23 in1  definirlos como GPIO pág 106
	 LPC_PINCON->PINSEL1|=(0<<16) | (0<<17); // p0.24 in2
//	 LPC_PINCON->PINSEL0|=(0<<0) | (0<<1); // p0.0 in1  definirlos como GPIO pág 106
//	 LPC_PINCON->PINSEL0|=(0<<2) | (0<<3); // p0.1 in2
	 LPC_PINCON->PINSEL0|=(0<<20) | (0<<21); // p0.10 in3
	 LPC_PINCON->PINSEL0|=(0<<22) | (0<<23); // p0.11 in4
	 LPC_PINCON->PINSEL1|=(0<<22) | (0<<23); // p0.27 encoder sentido rueda dcha
	 LPC_PINCON->PINSEL1|=(0<<24) | (0<<25); // p0.28 encoder sentido rueda izqda
	
	 LPC_GPIO0->FIODIR2|=(1<<7); //definimos como salida   pág 122
	 LPC_GPIO0->FIODIR3|=(1<<0);
//	 LPC_GPIO0->FIODIR0|=(1<<0);
//	 LPC_GPIO0->FIODIR0|=(1<<1);
	 LPC_GPIO0->FIODIR1|=(1<<2);
	 LPC_GPIO0->FIODIR1|=(1<<3);
	 LPC_GPIO0->FIODIR3|=(0<<3); //como entradas las señales del sentido de los encoders
	 LPC_GPIO0->FIODIR3|=(0<<4);	 
}


// ISR Timer 2 
void TIMER2_IRQHandler(void) {
	
  static uint32_t  temp;
  static uint32_t  temp2;
  float Lpulso= 2*pi*R/PPV ;
	segundos++; //para controlar que suene 1/20 segundos
	if ((LPC_TIM2->IR & 0x10) == 0x10){ //interrupe por captura 0 ?
		LPC_TIM2->IR |= (1<<4); //borro flag cap0
		N1=LPC_TIM2->CR0 - temp;    // Nº de cuentas de T1TC entre dos flancos consecutivos								
		frecuencia1 = Fpclk/N1;     // frecuencia en Hz.
		temp = LPC_TIM2->CR0;      // almacenamos la captura
		
		if (LPC_GPIO0->FIOPIN & (1<<27)){
       contadorPulsos1++;	
			 velocidad1D=Lpulso*frecuencia1; //procedimiento 1
		 }
		else {
			contadorPulsos1--;
			velocidad1D=-Lpulso*frecuencia1; //procedimiento 1
		}
	}	
	
	if ((LPC_TIM2->IR & 0x20) == 0x20){ //interrupe por captura 1 ?
		LPC_TIM2->IR |= (1<<5); //borro flag cap1	
		N2=LPC_TIM2->CR1 - temp2;    // Nº de cuentas de T1TC entre dos flancos consecutivos								
		frecuencia2 = Fpclk/N2;     // frecuencia en Hz.
		temp2 = LPC_TIM2->CR1;      // almacenamos la captura
		
		if (LPC_GPIO0->FIOPIN & (1<<28)){
       {contadorPulsos2--;}
			 	velocidad1I=-Lpulso*frecuencia2;
		 }
		else {
			contadorPulsos2++;
			velocidad1I=Lpulso*frecuencia2;
    }
	}	
	
	if ((LPC_TIM2->IR & 0x01) == 0x01){ //interrumpe por match cada 100ms ?
		LPC_TIM2->IR |= (1<<0); //borro flag mr0 pág 74
		LPC_TIM2->MR0 = LPC_TIM2->MR0 + N100ms; //incremento MR0 porque el TC no se resetea 
		velocidad2D=Lpulso*contadorPulsos1/T_tim2; //procedimineto 2
	  velocidad2I=Lpulso*contadorPulsos2/T_tim2;
		Lder=contadorPulsos1*Lpulso;//avance por deltaT = 100ms	
		LderT += Lder;  			//avance total
		Lizq=contadorPulsos2*Lpulso;
	  LizqT += Lizq;
		Distancia= (LderT+LizqT)/2;
		posicionDeltaT=(float)((Lizq-Lder)/DisRuedas)*DisGrad;
		posicion += (float)((Lizq-Lder)/DisRuedas)*DisGrad;
		
		if(flag==1) contador--; //para la función pausa
		
		if(posicion>180) posicion = posicion - 360;
		if(posicion<-180) posicion = posicion + 360;
		contadorPulsos1=0;
		contadorPulsos2=0;
	}				
}

void configTimer2(void){
   
    LPC_SC->PCONP|=(1<<22);         // Power ON: Timer 2
    LPC_PINCON->PINSEL0|= (1<<8) | (1<<9);     // p0.04 cap2.0  rueda DERECHA
	  LPC_PINCON->PINSEL0|= (1<<10) | (1<<11);     // p0.05 cap2.1  rueda IZQUIERDA 

    LPC_TIM2->PR  = 0x0;
    LPC_TIM2->MCR |= 0x1;  // interrumpe en MR0 pero no resetea
	  LPC_TIM2->MR0 = Fpclk*T_tim2 - 1; 
    LPC_TIM2->CCR = 0x36;  // que capture en flanco de bajada cap0 y cap1 e interrumpa pág 494
    LPC_TIM2->TCR |= 0x3;    // habilito y reseteo
	  LPC_TIM2->TCR &= ~ (1 << 1); //quito reset 	
		NVIC_EnableIRQ(TIMER2_IRQn);
		NVIC_SetPriority(TIMER2_IRQn,0); 
    NVIC_ClearPendingIRQ(TIMER2_IRQn);
}

void recto(int dist){
	int v=45;	
	if(sentido==0){		
		velDerecha= v -0.5*(0 - posicion) ; 
		velIzquierda= v +0.5*(0- posicion) ;
	}
	if(sentido==1){
		velDerecha= -v +0.5*(0 - posicion) ; 
		velIzquierda= -v +0.5*(0- posicion) ;
	}
		setVelDerecha(velDerecha);
		setVelIzquierda(velIzquierda);
}

void pausa(int temp){
	contador=temp/T_tim2;
	flag=1; //para que empiece a contar
	velIzquierda=0;
	velDerecha=0;
	setVelDerecha(velDerecha);
	setVelIzquierda(velIzquierda);	
}

void giro(int angulo){
	if(angulo==0){  //giro derecha
		velIzquierda=45;
		velDerecha=0;
	}
	if(angulo==1){  //giro izquierda
		velIzquierda=0;
		velDerecha=45;
	}	
	setVelIzquierda(velIzquierda);
	setVelDerecha(velDerecha);
}


void mostrarpantalla(void){
	
			if (zonePressed(&zone_3))
        if(velDerecha>-100){ velDerecha--;  velIzquierda--; setVelDerecha(velDerecha); setVelIzquierda(velIzquierda);}
      if (zonePressed(&zone_6))
        if(velDerecha<100){ velDerecha++; velIzquierda++;  setVelDerecha(velDerecha); setVelIzquierda(velIzquierda);}
				
	 
     sprintf(texto1,"%3d %c",velIzquierda ,37);
		 sprintf(texto2,"%3d %c ", velDerecha,37);
		 sprintf(texto3,"Posicion=%4.0f grados", posicion);
		 sprintf(texto4,"Distancia=%4.1f cm", Distancia);
		 sprintf(texto5,"Vel 1d=%4.0f cm/s", velocidad1D);
		 sprintf(texto6,"Vel 2d=%4.0f cm/s", velocidad2D);
		 sprintf(texto7,"Vel 1i=%4.0f cm/s", velocidad1I);
		 sprintf(texto8,"Vel 2i=%4.0f cm/s", velocidad2I);
		 sprintf(texto9,"Bat=%4d mV", tensionBateria);
		 sprintf(texto10,"Umbral=%d V", tensionPot);
		 sprintf(texto11,"Comando=%s", cadena);
 
			
     GUI_Text(zone_4.x + zone_4.size_x/2 - (strlen(texto1)/2)*8, zone_4.y + zone_4.size_y/2 - 8,
             (uint8_t*) texto1, White, Black);	
		 GUI_Text(zone_5.x + zone_5.size_x/2 - (strlen(texto2)/2)*8, zone_5.y + zone_5.size_y/2 - 8,
             (uint8_t*) texto2, White, Black);	
		 GUI_Text(zone_8.x + zone_8.size_x/2 - (strlen(texto3)/2)*8, zone_8.y + zone_8.size_y/2 - 8,
             (uint8_t*) texto3, White, Black);	
		 GUI_Text(zone_9.x + zone_9.size_x/2 - (strlen(texto4)/2)*8, zone_9.y + zone_9.size_y/2 - 8,
             (uint8_t*) texto4, White, Black);	
     GUI_Text(zone_11.x + zone_11.size_x/2 - (strlen(texto5)/2)*8, zone_11.y + zone_11.size_y/2 - 8,
             (uint8_t*) texto5, White, Black);
		 GUI_Text(zone_12.x + zone_12.size_x/2 - (strlen(texto6)/2)*8, zone_12.y + zone_12.size_y/2 - 8,
             (uint8_t*) texto6, White, Black);				 
		 GUI_Text(zone_13.x + zone_13.size_x/2 - (strlen(texto7)/2)*8, zone_13.y + zone_13.size_y/2 - 8,
             (uint8_t*) texto7, White, Black);
		 GUI_Text(zone_14.x + zone_14.size_x/2 - (strlen(texto8)/2)*8, zone_14.y + zone_14.size_y/2 - 8,
             (uint8_t*) texto8, White, Black);
						 
		if(M_manual==1){
		 GUI_Text(zone_16.x + zone_16.size_x/2 - (strlen(texto9)/2)*8, zone_16.y + zone_16.size_y/2 - 8,
             (uint8_t*) texto9, White, Black);
		 GUI_Text(zone_17.x + zone_17.size_x/2 - (strlen(texto10)/2)*8, zone_17.y + zone_17.size_y/2 - 8,
             (uint8_t*) texto10, White, Black);
			if(tensionBateria<(tensionPot*1000)){ 
				squareButton(&zone_18, "Bat. Baja", Red, Red);	
			}	
			else {squareButton(&zone_18, "Bat. Baja", Black, Black);}
		}
		if(M_auto==1){
		 GUI_Text(zone_15.x + zone_15.size_x/2 - (strlen(texto11)/2)*8, zone_15.y + zone_15.size_y/2 - 8,
             (uint8_t*) texto11, White, Black);
		}
		if(M_debug==1){
			squareButton(&zone_15, "IP: 192.168.1.120", White, Blue2);
		}
}


void maquinaEstados(){

	switch (estado){
		static int i=0;	
			
		case 0: //inicio
			if(cadena[i]=='R'){
				a=1;
				LderT=0;
				LizqT=0;
				Distancia=0;
				sentido=0;
				estado=1; //paso a signo
		  }	
			if(cadena[i]=='P'){
				a=0;
				estado=1; //paso a signo
			}
			if(cadena[i]=='D') estado=4; //paso a derecha
			if(cadena[i]=='I') estado=5; //paso a izquierda
			if(cadena[i]=='A') estado=6; //paso a reproducir
			if(((cadena[i]==13) || (cadena[i]==0))&& (flagServer==1)){ //para ver el fin de cadena y borrar la cadena, para UART 13 es enter y para Server /0
			 i=0;	
			 flagServer=0;
			 memset(cadena, 0, sizeof(cadena));
			 memset(buffer, 0, sizeof(buffer));
			 velDerecha=0;
			 velIzquierda=0;
			}	
			break;
		
		case 1: //signo
			i++;
			if((cadena[i]>='0') && (cadena[i]<='9')){
				estado=2; //paso a adquisición
			}
			if (cadena[i]=='-'){
				sentido=1; //sentido negativo
				estado=1;	//vuelvo a signo
			}	
			break;
		
		case 2: //adquisición
			dist=dist*10+cadena[i]-'0';
			i++;
			if((cadena[i]>='0') && (cadena[i]<='9') ) estado=2; //si es número me quedo aquí
			if((cadena[i]<'0') || (cadena[i]>'9')) estado=3;  //si no es número, a ejecución
			break;
		
		case 3: //ejecucuión
		  if(a==1) recto(dist); 
			if(a==0) pausa(dist);
			if(fabs(Distancia)>=dist){
				setVelDerecha(0);
				setVelIzquierda(0);
				dist=0;
				Distancia=0;
				posicion=0;
				estado=0; //vuelvo a inicio
			}
			if(contador==0){
				flag=0;
				dist=0;
				estado=0;  //vuelvo a inicio
			}			
			break;
		
		case 4: //derecha
			angulo=0;
			giro(angulo);
			
			if(posicion>=90){
				setVelIzquierda(0);
				velIzquierda=0;
				i++;
			  posicion=0;
				estado=0; //a inicio				
	  	}
			break;
		
		case 5: //izquierda
			angulo=1;
			giro(angulo);
			if(posicion<=-90){
				setVelDerecha(0);
				velDerecha=0;
				i++;
				posicion=0;
				estado=0; //a inicio
			} 
			break;	
		case 6: //reproducir
			audio=1;//reproduce el audio
			LPC_TIM3->TCR=0x01;		//Start Timer .
		  LPC_TIM3->MR0= Fpclk/8000 -1;
			if(fin==1){
				fin=0;
				i++;	
				estado=0; //a inicio
				LPC_DAC->DACR=0;
				LPC_TIM3->TCR=0x02;	//Stop Timer and reset
			}
  	break;
  }
}

void init_ADC(void)
{	
   LPC_SC->PCONP|= (1<<12);                           // POwer ON
   LPC_PINCON->PINSEL1|= (1<<18);            // (AD0.2)  (P0.25) batería 
   LPC_PINCON->PINMODE1|=(2<<18);           // Deshabilita pullup/pulldown
   LPC_PINCON->PINSEL3|= ((unsigned int)3<<30);                     // (AD0.5) (P1.31) potenciómetro
   LPC_PINCON->PINMODE3|= ((unsigned int)2<<30);                    // Deshabilita pullup/pulldown
   LPC_SC->PCLKSEL0|= (0x00<<8);                      // CCLK/4 (Fpclk después del reset) (100 Mhz/4 = 25Mhz)
   LPC_ADC->ADCR|=(1<<2)|(1<<5)                // canales 2,5
                        | (4<<8)                   // CLKDIV=4   (Fclk_ADC=25Mhz /(4+1)= 5Mhz) para que al mver Umbral no se mueva Bat
                        | (0x01<<21);                 // PDN=1
   // Ojo no se habilita el modo BURST en la inicialización  
   LPC_ADC->ADINTEN=(1<<5);					// Hab. interrupción fin de conversión del ÚLTIMO canal(canal 5)
   NVIC_EnableIRQ(ADC_IRQn);					// 
   NVIC_SetPriority(ADC_IRQn,4);			   //         
}	

void TIMER1_IRQHandler(void)
{	
   LPC_ADC->ADCR|=(1<<16); // BURST=1 --> Cada 65TclkADC se toma una muestra de cada canal comenzando   //  desde el más bajo (bit LSB de CR[0..7])
   LPC_TIM1->IR|=(1<<1);   // Borrar flag interrupción
	 switch(audio){
		case 0: 
			LPC_TIM3->MR0= Fpclk/2000/20 -1; //Fs para tono
		break;
		case 1:
			LPC_TIM3->MR0= Fpclk/8000 -1; // Fs mensaje audio
		break;
	 }
	 if(segundos >= (20/T_tim2)){
		segundos=0;
		LPC_TIM3->TCR=0x01;		//Start Timer.
	 	}
	 if(tensionBateria<tensionPot*1000){ 
			audio=0;
		 if(vez==0){
				segundos=0;
			  vez=1;
			  activo=1;
		}
		LPC_TIM3->TCR=0x01;		//Start Timer.
	 }
	 else{
		 vez=0;
		 LPC_TIM3->TCR=0x02;
	 }
}

void ADC_IRQHandler(void)
{	
	LPC_ADC->ADCR&=~(1<<16); // BURST=0     // Deshabilitamos el modo Ráfaga (ojo continua la conversión del siguiente canal) 
  
   //Almacenamos las muestras a modo de ejemplo
   Bateria= ((LPC_ADC->ADDR2 >>4)&0xFFF)*3300/4095;	// BATERÍA          
   tensionPot= ((LPC_ADC->ADDR5 >>8)&0xFF)*3.3/255+5;	// POTENCIÓMETRO  8 bits 
	 if(indice<=9){ //para hacer la media de 10 medidas
		array[indice]=Bateria;
		aux=array[indice]+aux;
		indice++;
	 }
	 else{
		tensionBateria=aux/10;
		tensionBateria=tensionBateria*3;
		indice=0;
		aux=0;
	 }	
}

void init_TIMER1(void)
{
   LPC_SC->PCONP|=(1<<2);                 //  power ON
   LPC_TIM1->MCR = 0x18;                  //  Interrupt on Match 1 and Reset TC
   LPC_TIM1->MR1 = (Fpclk/F_muestreo)-1; //  Periodo de muestreo de TODAS las entradas!!!!   
   LPC_TIM1->TCR = 0x01;                  //  
   NVIC_EnableIRQ(TIMER1_IRQn);           //  
   NVIC_SetPriority(ADC_IRQn,3);          // 
}	

void genera_muestras_seno(void)
{
	uint16_t i;
	for(i=0;i<20;i++) muestrasTono[i]=(char)(127+127*sin(2*3.14*i/20));
}

void init_DAC(void)
{
	LPC_PINCON->PINSEL1|= (2<<20); 	 	// DAC output = P0.26 (AOUT)
	LPC_PINCON->PINMODE1|= (2<<20); 	// Deshabilita pullup/pulldown
	LPC_DAC->DACCTRL=0;								//
	LPC_DAC->DACR=0;  
}


/*  Timer 3 en modo Output Compare (reset T0TC on Match 0)
	Counter clk: 25 MHz 	MAT1.0 : On match, salida de una muestra hacia el DAC */
void init_TIMER3(void)
{
	  LPC_SC->PCONP|=(1<<23);						// 	
    LPC_TIM3->PR = 0x00;     	 				// 
    LPC_TIM3->MCR = 0x03;							// Reset TC on Match, and Interrupt!  
    LPC_TIM3->TCR = 0x02;							// Timer STOP y RESET
    NVIC_EnableIRQ(TIMER3_IRQn);			//
	  NVIC_SetPriority(TIMER3_IRQn,1);      
}

void init_Externas()
{
// Configuración interrupciones externas
LPC_PINCON->PINSEL4|=(0x01<<22); 		// P2.11 es entrada interrup. EXT 1 (pulsador Key1 en MIni-DK2)
LPC_SC->EXTMODE|=(1<<1);   					// Por Flanco,	
LPC_SC->EXTPOLAR=0;				  				// de bajada
NVIC_SetPriority(EINT1_IRQn, 7);		// Menor prioritaria!!! ;  sin CMSIS: NVIC->IP[18]=(4<<3); 
NVIC_EnableIRQ(EINT1_IRQn); 				// sin CMSIS: NVIC->ISER[0]=(1<<18);
	
LPC_PINCON->PINSEL4|=(0x01<<20); 		// P2.10 es entrada interrup. ISP (pulsador Key1 en MIni-DK2)
LPC_SC->EXTMODE|=(1<<0);   					// Por Flanco,	
LPC_SC->EXTPOLAR=0;				  				// de bajada
NVIC_SetPriority(EINT0_IRQn, 6);		// Menor prioritaria!!! ;  sin CMSIS: NVIC->IP[18]=(4<<3); 
NVIC_EnableIRQ(EINT0_IRQn); 				// sin CMSIS: NVIC->ISER[0]=(1<<18);
}

/* Key1 para el audio*/
void EINT1_IRQHandler()
{
	LPC_SC->EXTINT=(1<<1); // Borrar flag Externa 0
	LPC_TIM3->TCR=0x01;		//Start Timer .
	audio=1;//para en el timer sacar el audio
}

//ISP para cambiar el modo
void EINT0_IRQHandler()
{
	LPC_SC->EXTINT=(1<<0); // Borrar flag Externa 0
	modo++;
	if(modo==3){
		modo=0;
	}
						GUI_Text(zone_15.x + zone_15.size_x/2 - (strlen(texto11)/2)*8, zone_15.y + zone_15.size_y/2 - 8,
             (uint8_t*) texto11, Black, Black);
							squareButton(&zone_15, "IP: 192.168.1.120", Black, Blue2);
							GUI_Text(zone_16.x + zone_16.size_x/2 - (strlen(texto9)/2)*8, zone_16.y + zone_16.size_y/2 - 8,
								(uint8_t*) texto9, Black, Black);
							GUI_Text(zone_17.x + zone_17.size_x/2 - (strlen(texto10)/2)*8, zone_17.y + zone_17.size_y/2 - 8,
								(uint8_t*) texto10, Black, Black);
							if(tensionBateria<(tensionPot*1000)){ 
								squareButton(&zone_18, "Bat. Baja", Black, Black);	}	
							else {squareButton(&zone_18, "Bat. Baja", Black, Black);}	
	if(modo==0){
		M_debug=0;
		M_auto=0;
		M_manual=1;
	}
	if(modo==1){
		M_debug=0;
		M_auto=1;
		M_manual=0;
	}
	if(modo==2){
		M_debug=1;
		M_auto=0;
		M_manual=0;
	}


	if(parar==0){
		LPC_TIM3->TCR=0x01;		//Start Timer.
		audio=0;//para en el timer sacar el tono a 2kHz	
		segundos=0;
		LPC_DAC->DACR=0;	 // 0 V
	}
	if(parar==1){ //flanco de subida, se ha dejado de apretar el botón
		LPC_TIM3->TCR=0x02;	//Stop Timer and reset
		LPC_DAC->DACR=0;	 // 0 V
		LPC_SC->EXTPOLAR=0; //configuro para flanco de bajada
		parar=0;
		}
}

// Timer 3 interrumpe periódicamente a F_sample = 8000 Hz !!!!
// La muestra correpondiente del array,  se saca al DAC en cada interrupción
void TIMER3_IRQHandler(void)
{
	static uint16_t indice_muestra,i;
	LPC_TIM3->IR|= (1<<0); 													// Borrar flag
	if(audio==1){
		parar=0;
		LPC_SC->EXTPOLAR=0; //configuro para flanco de bajada
		LPC_DAC->DACR= muestras[indice_muestra++]<<8; // 8 bits!!!! saca las muestras
		if(indice_muestra>=N_muestras){
			indice_muestra=0;
			LPC_TIM3->TCR=0x02;	//Stop Timer and reset
			LPC_DAC->DACR=0;	 // 0 V
			fin=1;//para cambiar de estado en la máquina de estados
			audio=2;//para que no entre en ninguna hasta que se pulse la que se quiere, que vuelve a cambiar audio
		}
	}
	else{
		//LPC_SC->EXTPOLAR=(1<<0); //configuro para flanco de subida
		//parar=1;// para hacer lo del flanco de subida
		if(segundos <= (1/T_tim2)){
			LPC_DAC->DACR=muestrasTono[i++]<<8; 
			if((i>=20)) { 
				i=0;
			}
		}
		else{ //entro con audio=2 para no sacar nada
			LPC_DAC->DACR=0;
			LPC_TIM3->TCR=0x02;	//Stop Timer and reset
		}
	}
}	

void maquinaEstadosUart(void){
	switch(estadoUart){
		case 0: //enviado
			if(tx_completa==1){
				estadoUart=1;
			}
		break;
		case 1: //recibido
			switch(opcion){
				case 0://bienvenida
					if(rx_completa==1){
						rx_completa=0;
						sprintf(buffer_tx,"\nHola %s \r\n\n Introduce un comando: GetPosicion,SetModo,SetComando,SetVel,GetVel,fin \n\r",buffer); // Prepara la respuesta incluyendo la info recibida
						tx_cadena_UART0(buffer_tx);
						opcion=2;
						estadoUart=0;
					}
				break;
				case 1:
					tx_cadena_UART0("\n Introduce un comando\n\r");
					estadoUart=0;
					opcion=2;
				break;
				case 2: //comparacion
					if(rx_completa==1){
						rx_completa=0;
						if (strcmp (buffer, "fin\r") == 0)	{
							estadoUart=2;
							opcion=1;
						}
						else if (strcmp (buffer, "GetPosicion\r") == 0){
							sprintf(buffer_tx,"\nDistancia=%.2f cm, Grados=%.2f\n\r",Distancia,posicion); 
							tx_cadena_UART0(buffer_tx);
							estadoUart=0;
							opcion=1;
						}
						else if (strcmp (buffer, "SetModo\r") == 0){				
							tx_cadena_UART0("\n Introduce un modo: Manual, Automatico o Debug\n\r");	
							estadoUart=0;
							opcion=3;
						}
						else if (strcmp (buffer, "SetComando\r") == 0){
							tx_cadena_UART0("\n Introduce una instruccion\n\r");
							estadoUart=0;
							opcion=4;
						}
						else if (strcmp (buffer, "SetVel\r") == 0){
							tx_cadena_UART0("\n Introduce una velocidad de -100 a 100\n\r");
							estadoUart=0;
							opcion=5;
						}	
						else if (strcmp (buffer, "GetVel\r") == 0){
							sprintf(buffer_tx,"Vel1D=%.2f cm/s Vel1I=%.2f cm/s Vel2D=%.2f cm/s Vel2I=%.2f cm/s\n\r",velocidad1D,velocidad1I,velocidad2D,velocidad2I); 
							tx_cadena_UART0(buffer_tx);
							estadoUart=0;
							opcion=1;
						}	
						else {
							tx_cadena_UART0("Comando erroneo\n\r");
							estadoUart=0;
							opcion=1;
						}						
					}
				break;
				case 3://SetModo
					if(rx_completa==1){ //esperando a que se haya terminado de recibir
						rx_completa=0;						
						//para no sobrescribir en la pantalla al cambiar de modo en la UART
						GUI_Text(zone_15.x + zone_15.size_x/2 - (strlen(texto11)/2)*8, zone_15.y + zone_15.size_y/2 - 8,
             (uint8_t*) texto11, Black, Black);
							squareButton(&zone_15, "IP: 192.168.1.120", Black, Blue2);
							GUI_Text(zone_16.x + zone_16.size_x/2 - (strlen(texto9)/2)*8, zone_16.y + zone_16.size_y/2 - 8,
								(uint8_t*) texto9, Black, Black);
							GUI_Text(zone_17.x + zone_17.size_x/2 - (strlen(texto10)/2)*8, zone_17.y + zone_17.size_y/2 - 8,
								(uint8_t*) texto10, Black, Black);
							if(tensionBateria<(tensionPot*1000)){ 
								squareButton(&zone_18, "Bat. Baja", Black, Black);	}	
							else {squareButton(&zone_18, "Bat. Baja", Black, Black);}								
						if (strcmp (buffer, "Debug\r") == 0){
							modo=2;
							M_debug=1;
							M_auto=0;
							M_manual=0;
							sprintf(buffer_tx,"\nModo:%d\n\r",modo); 
							tx_cadena_UART0(buffer_tx);
							estadoUart=0;
							opcion=1;
						}
						else if (strcmp (buffer, "Automatico\r") == 0){
							modo=1;
							M_debug=0;
							M_auto=1;
							M_manual=0;
							sprintf(buffer_tx,"\nModo:%d\n\r",modo); 
							tx_cadena_UART0(buffer_tx);
							estadoUart=0;
							opcion=1;
						}
						else if (strcmp (buffer, "Manual\r") == 0){
							modo=0;
							M_debug=0;
							M_auto=0;
							M_manual=1;
							sprintf(buffer_tx,"\nModo:%d\n\r",modo); 
							tx_cadena_UART0(buffer_tx);
							estadoUart=0;
							opcion=1;
						}
					}
				break;
				case 4://SetComando
					if(rx_completa==1){
						rx_completa=0;
						strcpy(cadena,buffer);
						sprintf(buffer_tx,"%s \n\r",cadena); 
						tx_cadena_UART0(buffer_tx);
						estadoUart=0;
						opcion=1;		
						flagServer=1;
					}
				break;	
				case 5://SetVelocidad
					if(rx_completa==1){
						rx_completa=0;
					  vel=atoi(buffer);
						setVelDerecha(vel);
						setVelIzquierda(vel);
						sprintf(buffer_tx,"Velocidad=%d \n\r",vel); 
						tx_cadena_UART0(buffer_tx);
						estadoUart=0;
						opcion=1;
					}
				break;
			}
			break;
			case 2: //fin de programa
				tx_cadena_UART0("FIN del programa\n\r"); 
				estadoUart=10;//para que no vuelva a entrar
			break;
	}
}

void init_UART(void){
	ptr_rx=buffer;	                // inicializa el puntero de recepción al comienzo del buffer
	uart0_init(9600);							 // configura la UART0 a 19200 baudios, 8 bits, 1 bit stop
	NVIC_SetPriority(UART0_IRQn,2);  // Prioridad Máxima
	tx_cadena_UART0("Esto es una prueba de la UART0 del LPC1768 a 9600 baudios\n\r"
				"Introduce tu nombre y apellidos\n\r");
}	

void TIMER0_init(){
	
	LPC_SC->PCONP |= 1<<1;
	LPC_PINCON->PINSEL7|= 2<<20;  // MAT0.1 en P3.26

	LPC_TIM0->PR = 0;
	LPC_TIM0->MCR = 1<<1 | 1<<0;  // RESET and IRQ on MR0
	LPC_TIM0->MR0 =  25E+6;				// 1 s IRQ  

	NVIC_SetPriority(TIMER0_IRQn,5);  
	NVIC_EnableIRQ(TIMER0_IRQn);    

	LPC_TIM0->TCR = 1<<1;         // RESET TIM0
	LPC_TIM0->TCR = 1<<0;         // START TIM0. JAMAS TCR |= 1<<0	
}

//---------------------------------------------------------------------------

void mando_init(){ //para inicializar, común a todos los mandos negros	
	I2Cdelay();
	I2Cdelay();
	I2CSendAddr(0x52,0);
	I2CSendByte(0xF0);
	I2CSendByte(0x55);
	I2CSendStop();
	I2Cdelay();
	I2CSendAddr(0x52,0);
	I2CSendByte(0xFB);
	I2CSendByte(0x00);
	I2CSendStop();
}


void leerMando(){
	I2CSendAddr(0x52,0);
	I2CSendByte(0x00);
	I2CSendStop();
	I2CSendAddr(0x52,1);
	datoY=I2CGetByte(0); //I2CGetByte(0)^ 0x17 + 0x17
	datoX=I2CGetByte(0);
	datoBasura=I2CGetByte(0);
	datoBasura=I2CGetByte(0);
	datoBasura=I2CGetByte(0);
	datoZC=I2CGetByte(1);
	datoZ=datoZC & 0x01;
	datoC=(datoZC & 0x02) >> 1; //último dato leído	
	I2CSendStop();
	
	
	if(datoX==-1){
		setVelDerecha(60);
		setVelIzquierda(60);
	}
	else if(datoX==1){
		setVelDerecha(-60);
		setVelIzquierda(-60);
	}
	else if (datoY==-1){
		setVelDerecha(0);
		setVelIzquierda(50);
	}
	else if (datoY==1){
		setVelDerecha(50);
		setVelIzquierda(0);
	}
	else{ // como posición central, que no se mueva
		setVelDerecha(0);
		setVelIzquierda(0);
	}
	if(datoZ==0){
		estado=6;
		//LPC_TIM3->TCR=0x01;		//Start Timer .
		//audio=1;//para en el timer sacar el audio
	}
}

void TIMER0_IRQHandler(void) { //cada segundo para leer el mando
	LPC_TIM0->IR = 1<<0;
	if(segundos >= (20/T_tim2)){
		segundos=0;
		LPC_TIM3->TCR=0x01;		//Start Timer.
	 	}
	if(M_manual==1){
		leerMando();
	}
}

 void modos(void){
	 if(cambioServer==1){
	 	//para no sobrescribir en pantalla cuando se ha recibido algo del server
				cambioServer=0;
						GUI_Text(zone_15.x + zone_15.size_x/2 - (strlen(texto11)/2)*8, zone_15.y + zone_15.size_y/2 - 8,
             (uint8_t*) texto11, Black, Black);
							squareButton(&zone_15, "IP: 192.168.1.120", Black, Blue2);
							GUI_Text(zone_16.x + zone_16.size_x/2 - (strlen(texto9)/2)*8, zone_16.y + zone_16.size_y/2 - 8,
								(uint8_t*) texto9, Black, Black);
							GUI_Text(zone_17.x + zone_17.size_x/2 - (strlen(texto10)/2)*8, zone_17.y + zone_17.size_y/2 - 8,
								(uint8_t*) texto10, Black, Black);
							if(tensionBateria<(tensionPot*1000)){ 
								squareButton(&zone_18, "Bat. Baja", Black, Black);	}	
							else {squareButton(&zone_18, "Bat. Baja", Black, Black);}	
		}
	if (M_manual == 1){
		memset(cadena, 0, sizeof(cadena)); // no hacer caso al comando
	}
	else if (M_debug == 1){
		checkTouchPanel();
		memset(cadena, 0, sizeof(cadena));
	}
	else if (M_auto == 1){
		
	}
 }
 
void WDTInit(void){
	LPC_WDT->WDTC=(Fpclk/4)*2;
	LPC_WDT->WDCLKSEL=0x01;
	LPC_WDT->WDMOD=0x03;
	LPC_WDT->WDFEED=0xAA;
	LPC_WDT->WDFEED=0x55;
}

void WDTFeed(void){
	LPC_WDT->WDFEED=0xAA;
	LPC_WDT->WDFEED=0x55;
}

 
/*******************************************************************************
* Function Name  : main
* Description    : Main program
* Input          : None
* Output         : None
* Return         : None
* Attention		  : None
*******************************************************************************/
int main(void)
{ 
  init ();
	
	genera_muestras_seno(); // genera las muestras para el tono
	NVIC_SetPriorityGrouping(4);	
  LCD_Initializtion();
  LCD_Clear(Black);	
  TP_Init();
  pines();	 
	configTimer2(); //para los encoders con los CAP y cada 100ms
	init_ADC();
  init_TIMER1(); //para quitar el modo burst del ADC
	configPWM(); //para los enable de las ruedas
  screenMain();
  init_Externas();
	init_DAC();
	init_TIMER3(); // el que saca las muestras del DAC
	init_UART();
	mando_init();
	TIMER0_init(); //cada segundo, para leer el mando I2C
  //WDTInit();
	I2Cdelay();					// Para visualizar en simulacion un retardo desde el RESET
  I2Cdelay();
  
	while (1)	
	{
      timer_poll ();
      main_TcpNet ();			
			maquinaEstados(); //decodifica
		  mostrarpantalla();  
		  maquinaEstadosUart(); //para leer lo que llega de la uart y esperar a que se termine de enviar
			modos(); //los tres modos
			//WDTFeed(); //comentar para ver la ejecutabilidad
	}
}

/*********************************************************************************************************
      END FILE
*********************************************************************************************************/
